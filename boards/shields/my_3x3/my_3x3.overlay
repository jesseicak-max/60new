/{
kscan0: kscan_matrix {
    compatible = "zmk,kscan-gpio-matrix";
    row-gpios = <&gpio0 8 GPIO_ACTIVE_HIGH>,
                <&gpio0 6 GPIO_ACTIVE_HIGH>,
                <&gpio0 17 GPIO_ACTIVE_HIGH>;
    col-gpios = <&gpio0 20 GPIO_ACTIVE_HIGH>,
                <&gpio0 22 GPIO_ACTIVE_HIGH>,
                <&gpio0 24 GPIO_ACTIVE_HIGH>;
    status = "okay";
};
chosen {
    zmk,kscan = &kscan0;
};
};
